NAME MAIN

	GLOBAL DEVPS2	
	GLOBAL DEVLCD
	GLOBAL DEVSER
	GLOBAL RAMAD
	GLOBAL MENU
	GLOBAL KEYCTR
	GLOBAL SOUTAS;

	DEVPS2	EQU $46 ;PS/2 Keyb
	DEVLCD	EQU $40	;LCD
	DEVSER 	EQU $20	;Serial
	COPSTA	EQU   6	; COP STATUS PORT

	;PINS EQU DEVLCD 	;LCD INSTRUCTION PORT
	;PDAT EQU DEVLCD+01	;LCD DATA SEND PORT


	PS2OUT	EQU DEVPS2
	PS2IN 	EQU DEVPS2+1

	TXTRAM EQU 642		; 5 SHL 7 +2

	KEYCTR EQU $F1		;IN NB SYSTEM VARS
	SERERR EQU $F2;

	RAMAD EQU $6000
	
	STACKP EQU RAMAD+100  	;100


	;DISPCT EQU 8+4		;DISPLAY CONTROL
				;BIT 0= BLINK CURSOR POS CHAR
				;BIT 1= CURSOR ON OFF
				;BIT 2=	DISPLAY ON OFF
				;BIT 3= 1	
	LCDCX EQU RAMAD+6	;DB 0		;DISPLAY X POS (0..F  FOR 1..16)
	LCDCY EQU RAMAD+7 	;DB 0		;DISPLAY Y POS (0 OR 1 FOR LINE 1 AND 2)

	SERER2 	EQU RAMAD+0	;AT RAM ADDRESS
	PRGEX	EQU RAMAD+10 	;2 BYTES

	TVSTAT	EQU RAMAD+20


	MYNUM	EQU $6500
	
	KDATA	EQU 6	;DATA FLAGS SET TO 1 IF UNTRANSMITTED

	ORG $8000
	
	;ADD A,B			;$80 SIGNALS NO ROM HERE FOR NB OS
	CPL			;ROM IS HERE
	JP START
	JP GETKEY		;CALL HERE FROM NB ROM TO FIND THE GTNBKEY  $8004
	JP RSTX 			; CALL HERE FROM NB TO FIND SERIAL TRASMIT  $8007
	JP RSRX			; CALL HERE FROM NB TO FIND SERIAL RECEIVE  $800A
	JP MENU

GETKEY 	PUSH HL
	PUSH DE
	PUSH BC
RGT:	CALL GTNBKEY	;KEY PRESSED
	;for trapping
	;PUSH AF
	;CALL SOUTAS
	;LD HL,$026F  ;FLAGS
	;LD A,(HL)
	;CALL SOUTAS
	;POP AF
	;
	POP BC
 	POP DE 
 	POP HL
 	CP 0				;CHECK IF INVALID KEY
 	RET NZ 							
 	RES KDATA (HL)							 ; KEY INVALID RESET KDATA TEST BIT
  	INC HL 			;GET TO THE LAST VALID KEY
	LD A,(HL)
	DEC HL  	
 	RET	

RSTX 	CALL RS_TX
	RET
	
RSRX	CALL RS_RX
	RET	
	

SOUTAS	PUSH AF  	;SERIAL PRINT ASCII IN DECIMAL
	LD H,0
	LD L,A
	LD DE,MYNUM
	CALL OUTASC
	
	LD A,10
	LD (DE),A
	INC DE
	LD A,13
	LD (DE),A
	INC DE
	XOR A
	LD (DE),A

	LD HL,MYNUM
	CALL RS_TXT
	POP AF
	RET


START	DI
	LD HL,0
	LD A,(HL)
	CP $F3
	;JP Z,$E090	;BOOT NEWBRAIN
	JP NZ,CN1 	
	CALL STNEWD	;SET NEWDRIVERS AND DEFSTORE DEVICE
	LD HL,STRBT
	CALL RS_TXT	;OUTPUT MENU COMMANDS AT RS232	
	JP MENU



	;OUT 5 TIMES AT PORT 0 (0 AND 255)
CN1:	LD B,5
AGN1	LD C,0
	LD A,0
	OUT (C),A
	LD C,0
	LD A,255
	OUT (C),A
	DJNZ AGN1

		
	;TEST RAM
	
	LD DE,1
	LD A,0		;WRITE 0
	LD C,A
	LD HL,RAMAD	
	LD B,8
AGN2	LD (HL),A
	LD C,(HL)
	CP C
	JP NZ, ERR
	ADD HL,DE
	ADD A,32	;WRITE +32
	LD C,A
	DJNZ AGN2
	
	LD B,5
AGN3	LD C,2
	LD A,64
	OUT (C),A
	ADD A,128
	OUT (C),A	
	DJNZ AGN3  	; SIGNAL ALL OK CONTINUOUS 10 TIMES ON PORT 2
	JP BOOT


ERR	LD C,1
	LD A,64
	OUT (C),A
	
	JP ERR 	;DO AGAIN PORT 1

BOOT	IM 1 
	DI


	LD SP,STACKP
	
	XOR A
	OUT (7),A	; tv oFF
	LD A,2
	OUT (12),A	;TV CONTROL 	

	CALL LCDINI	;LCD 16x2 Initialized
	LD HL,STR0
	CALL LCDTXT

	;LD HL,STR1
	;CALL DELAY
	CALL RS_INI	;RS232 INITIALIZE
	LD HL,STR00
	CALL RS_TXT


	LD HL,STRSCR	
	CALL RS_TXT
	
	
	
	;LD HL,STR01
	;CALL RS_TXT	;OUTPUT WAITING AT RS232
	;LD A,3
	
	;CALL DELAY

	CALL SCCLS	;CLEAR SCREEN BUFFER

	LD HL,STR02	
	CALL SCPRN	;PRINT WAITING AT SCREEN BUFFER	


	CALL DELAY
	CALL DELAY


	
ALLOK	CALL TVOFF

MENU:	LD HL,STRMN
	CALL RS_TXT	;OUTPUT MENU COMMANDS AT RS232	
	LD HL,STR01
	CALL RS_TXT	;OUTPUT WAITING AT RS232
	
	CALL TVOFTM	
	CALL LCDCLS
	
	LD HL,STR02
	CALL LCDTXT
	CALL RESTV
	
	LD HL,SMENU
	LD A,2
	CALL SCPRN
		
	CALL RS_RX	; WAIT FOR A CHAR IN RS232	
	
	CP 'U'		;UPLOAD PROGRAM
	CALL Z, UPLOD
	CP 'X'
	JR Z,EXEC
	CP 'T'
	CALL Z,RSTST
	CP 'S'
	CALL Z,TXTSCR
	CP 'N'
	JP Z,$E003
	CP 'M'
	JP Z,$A015		;$E090
	CP 'C'
	CALL Z,TVON
	CP 'V'
	CALL Z,TVOFF
	CP 'I'
	CALL Z,UPLOD2
	CP 'Y'
	CALL Z,RSTST2
	CP 'H'
	CALL Z,XMTST
	CP 'J'
	CALL Z,DNLOD
	
	JP MENU

TVON:	PUSH HL
	LD HL,TVSTAT
	SET 2,(HL)
	POP HL
	JR RESTV  	
	

TVOFF:  PUSH HL
	LD HL,TVSTAT
	RES 2,(HL)
	POP HL
	JR RESTV	


TVOFTM	XOR A	;TV OFF
	OUT (7),A
	RET

RESTV:	PUSH HL
	LD HL,TVSTAT
	LD A,(HL)
	OUT (7),A
   	LD A,5
	OUT (9),A ; SET DISPLAY ADDRESS
	POP HL
	RET

EXEC:	CALL LCDCLS
	CALL LCDLN2
	LD HL,SPRGX
	CALL LCDTXT	
	CALL LCDLN1
	
	LD A,5
	CALL SCPRN			

	LD DE,PRGEX
	LD A,(DE)
	LD L,A
	INC DE
	LD A,(DE)
	LD H,A
	JP (HL)

UPLOD: 	CALL TVOFTM
	LD HL,DATST
	CALL LCDLN2
	CALL LCDTXT

	CALL RS_RX 	;HL HAS RAM ADDRESS
	LD L,A
	CALL RS_RX
	LD H,A
	CALL RS_RX	;BC HAS TOTAL DATA TO BE SEND
	LD C,A
	CALL RS_RX
	LD B,A
	
	LD DE,PRGEX 	;SAVE TO PRGEX THE PROG EXEC ADDR=HL
	LD A,L
	LD (DE),A
	INC DE
	LD A,H
	LD (DE),A
	
	CP $80
	JR Z,ROMWR
	JR C,NORWR

ROMWR	OUT (124),A 	;SET ROM WRITABLE = '0'




NORWR:	PUSH HL
NXB:	CALL RS_RX
	LD (HL),A
	INC HL
	DEC BC
	LD A,B
	OR C
	JR NZ,NXB	;LOOP ALL BYTES	

  	OUT (125),A 	;SET ROM NON WRITABLE ='1'

	LD HL,DATTR
	CALL LCDCLS
	CALL LCDTXT
	LD A,5	
	CALL SCPRN			
	CALL DELAY
	
	POP HL
	;CALL (HL)
	
	CALL RESTV

	RET



UPLOD2:	CALL TVOFTM
	LD HL,DATST
	CALL LCDLN2
	CALL LCDTXT

	CALL RS_RX 	;HL HAS RAM ADDRESS
	LD L,A
	CALL RS_RX
	LD H,A
	CALL RS_RX	;BC HAS TOTAL DATA TO BE SEND
	LD C,A
	CALL RS_RX
	LD B,A
	
	LD DE,PRGEX 	;SAVE TO PRGEX THE PROG EXEC ADDR=HL
	LD A,L
	LD (DE),A
	INC DE
	LD A,H
	LD (DE),A

NXB2:	CALL RS_RX
	LD (HL),A
	INC HL
	DEC BC
	LD A,B
	OR C
	JR NZ,NXB2	;LOOP ALL BYTES	  	
	
	CALL RESTV

	RET
	
DNLOD:	CALL TVOFTM
	;LD HL,DATST
	;CALL LCDLN2
	;CALL LCDTXT

	CALL RS_RX 	;HL HAS RAM ADDRESS
	LD L,A
	CALL RS_RX
	LD H,A
	CALL RS_RX	;BC HAS TOTAL DATA TO BE SEND
	LD C,A
	CALL RS_RX
	LD B,A
	
NXB3:	LD A,(HL)
	CALL RS_TX	;SEND BYTE
	INC HL
	DEC BC
	LD A,B
	OR C
	JR NZ,NXB3	;LOOP ALL BYTES	  	
	
	CALL RESTV

	RET

PS2AGN:			;TEST PS/2 INPUT
	IN A,(PS2IN)
	CP 0
	JR Z,PS2AGN
	CP 255
	JR Z,PS2AGN
	CP 1
	JP Z, PS2AGN
	;CALL LCDCHR
	CALL RS_TX
	CALL DEL2
	;CALL LCDCLS
	JR PS2AGN
	

RSTST:	NOP	;GET A KEY FROM RS232
	LD B,10
TEN:	PUSH BC
	CALL RS_RX
	;CALL LCDCHR  	;THE RECEIVED CHAR
	CALL RS_TX	;SEND BACK THE CHAR

	LD A,' '
	;CALL LCDCHR
	LD A,'R'
	;CALL LCDCHR
	
	CALL DEL2
	;CALL LCDCLS
	POP BC
	DJNZ TEN

	XOR A
	RET
	
RSTST2:	NOP	;TEST RECEIVING AND SENDING 255 BYTES
	LD B,255
TEN2:	PUSH BC
	CALL RS_RX
	;CALL LCDCHR  	;THE RECEIVED CHAR
	CALL RS_TX	;SEND BACK THE CHAR		
	;CALL DEL2
	POP BC
	DJNZ TEN2
	XOR A
	RET


XMTST:	NOP	;TEST XMIT ALL 8 BITS
	LD B,255
TEN3:	PUSH BC
	LD A,B
	CALL RS_TX	;SEND  THE BYTE
	POP BC
	DJNZ TEN3
	XOR A
	RET
	


TXTSCR: LD HL,TXTMES		;SCREEN START
	LD DE,TXTRAM
	LD BC,21
	LDIR

	LD HL,TXTMES
	LD DE,TXTRAM+64	;SCREEN START+64 40chars screen +24 excess
	LD BC,21
	LDIR

	XOR A
	RET
	

	
SMENU	DEFM "UI:UP,X:RUN,TYH:RS,S:DISP,NM:NBROM,CV:TV, J:DN"
	DB 0


STR0	DEFM "LCD INITIALIZED"
	DB 0

STR1	DEFM "RS232 INIT"
	DB 0

STR2	DEFM "PROGRAM HALTED"
	DB 0

STR02	DEFM "WAITING..."
	DB 0

DATTR	DEFM "PRG TRANSFERED"
	DB 0
	
DATST	DEFM "RECEIVING..."
	DB 0	

SPRGX	DEFM "PRG EXECUTE"
	DB 0
	
STIMG	DEFM "IMAGE COPY"
	DB 0

TXTMES	DEFM "NEWBRAIN SCREEN READY"
	DB 0



STRMN	DEFM "U:UP,X:RUN,T:RS,S:DISP,N:NBROM,C:TVON,V:TVOFF"
	DB 10,13,0


STRBT	DEFM "NEWBRAIN BOOTED OK"
	DB 10,13,0

STRSCR	DEFM "CLEARING SCREEN."
	DB 10,13,0

STR00	DB 10,13
	DEFM "RS232 INITIALIZED"
	DB 10,13,0

STR01	DB 10,13
	DEFM "WAITING..."
	DB 10,13,0
	DB 0

STR06	DB 10,13
	DEFM "KEY PRESSED"
	DB 10,13,0
	DB 0

	
	INCLUDE SERIAL.S
	INCLUDE LCD16X2.S
	INCLUDE SCRBUFFER.S
	INCLUDE PS2KEYB.S
	INCLUDE UTILS.S
	INCLUDE RSDEVDRIVER.S
	

	DB 128,0,128,0,255,255
IMAGE	DB 0

	END



