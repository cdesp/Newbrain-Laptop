INCLUDE ROMSYMS.S


ORG $7000

	LD HL,HEL1
	LD D,18
	CALL NBSTLCD
	LD B,80
LP	CALL DEL2
	DJNZ LP
	JP MENU


;HL HAS THE STRING TO OUTPUT
;D HAS THE NUMBER OF BYTES
;STRING IS IN REVERSE ORDER
NBSTLCD PUSH DE
	LD B,D		;TOTAL CHARS
	DEC B
	DEC B		;SKIP 2
	LD DE,17	;START FROM THE END
	ADD HL,DE			
	XOR A
	LD DE,LCDCX	;LCD POSITION
	LD (DE),A						
	INC DE
	LD (DE),A
	PUSH DE
	CALL LCDLIN	;SET LCD TO LCDCX,LCDCY														
	POP DE
	DEC DE		;POSITION ON LCDCX
	LD C,0		;LCD POSITION COUNT	
NBSETLP	LD A,(HL)	
	BIT 7,A		;CHECK IF CURSOR HERE
	JR Z,NBNXT
	PUSH AF
	LD A,C
	LD (DE),A	;POSITION CURSOR
	POP AF
	RES 7,A		;CLEAR CHAR FROM CURSOR INFO
NBNXT	CALL LCDCHR	;OUTPUT CHAR TO LCD
	DEC HL
	INC C
	DJNZ NBSETLP	;LOOP NEXT CHAR
	CALL LCDLIN	;POSITION CURSOR
	CALL LCDCON	;CURSOR ON
	CALL LCDBON
	LD A,49
	CALL LCDCHR
	POP DE
	RET



HEL1	DEFM "0012345"
	DB '6'+128
	DEFM "78NIARBWEN"


